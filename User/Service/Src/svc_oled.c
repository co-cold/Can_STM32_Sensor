#include "svc_oled.h"
#include "svc_i2c.h"
#include "bsp_oled.h"
#include "bsp_i2c.h"
#include <string.h>

/* 5x7 ASCII 字体（ASCII 32~126，每字符 5 字节） */
static const uint8_t Font5x7[][5] = {
    {0x00,0x00,0x00,0x00,0x00}, // space
    {0x00,0x00,0x5F,0x00,0x00}, // !
    {0x00,0x07,0x00,0x07,0x00}, // "
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    {0x08,0x04,0x08,0x10,0x08}, // ~
};

/**
 * @brief OLED 设备初始化
 * @note 创建显存锁，清空显存，调用 BSP 初始化序列，首次刷新
 */
void Svc_Oled_Init(svc_oled_t *oled)
{
    if (oled == NULL) return;

    /* 创建设备级锁，保护显存 */
    if (oled->fb_mutex == NULL) {
        const osMutexAttr_t mutex_attr = { .name = "OledFbMutex" };
        oled->fb_mutex = osMutexNew(&mutex_attr);
    }

    /* 清空显存 */
    memset(oled->framebuffer, 0x00, sizeof(oled->framebuffer));

    /* 调用 BSP 层初始化硬件 */
    Bsp_Oled_InitSequence();

    /* 首次刷新 */
    Svc_Oled_Refresh(oled);
}

/**
 * @brief 刷新显存到屏幕（全屏）
 * @note 先拿设备锁再拿总线锁，释放时先放总线锁再放设备锁，避免死锁
 */
void Svc_Oled_Refresh(svc_oled_t *oled)
{
    if (oled == NULL) return;

    /* 拿设备锁：避免刷新时显存被其他任务修改 */
    osMutexAcquire(oled->fb_mutex, osWaitForever);

    /* 拿总线锁：避免和其他 I2C 设备冲突 */
    osMutexAcquire(svc_i2c.bus_mutex, osWaitForever);

    /* 设置列地址范围 0~127 */
    uint8_t col_cmd[] = {0x00, 0x21, 0x00, 0x7F};
    Bsp_I2c_MasterTransmit(OLED_I2C_ADDR, col_cmd, sizeof(col_cmd));

    /* 设置页地址范围 0~7 */
    uint8_t page_cmd[] = {0x00, 0x22, 0x00, 0x07};
    Bsp_I2c_MasterTransmit(OLED_I2C_ADDR, page_cmd, sizeof(page_cmd));

    /* 写全屏显存（1KB） */
    Bsp_Oled_WriteBuff(oled->framebuffer, sizeof(oled->framebuffer));

    /* 释放锁（先放总线锁，再放设备锁） */
    osMutexRelease(svc_i2c.bus_mutex);
    osMutexRelease(oled->fb_mutex);
}

/**
 * @brief 画点
 * @note 仅修改显存，不刷新屏幕。多次画点后调用 Refresh 一次刷新
 */
void Svc_Oled_DrawPixel(svc_oled_t *oled, uint8_t x, uint8_t y, uint8_t color)
{
    if (oled == NULL) return;
    if (x >= OLED_WIDTH || y >= OLED_HEIGHT) return;

    osMutexAcquire(oled->fb_mutex, osWaitForever);

    if (color) {
        oled->framebuffer[x + (y / 8) * OLED_WIDTH] |= (1 << (y % 8));
    } else {
        oled->framebuffer[x + (y / 8) * OLED_WIDTH] &= ~(1 << (y % 8));
    }

    osMutexRelease(oled->fb_mutex);
}

/**
 * @brief 显示字符串（5x7 ASCII 字体）
 * @note 仅修改显存，不刷新屏幕。超出宽度自动换行
 */
void Svc_Oled_ShowString(svc_oled_t *oled, uint8_t x, uint8_t page, const char *str)
{
    if (oled == NULL || str == NULL) return;
    if (page >= OLED_PAGES) return;

    osMutexAcquire(oled->fb_mutex, osWaitForever);

    while (*str) {
        /* 越界保护：超出宽度则换行 */
        if (x > OLED_WIDTH - 6) {
            x = 0;
            page++;
            if (page >= OLED_PAGES) break;
        }

        /* 获取字体数据 */
        uint8_t c = (uint8_t)*str;
        if (c >= 32 && c <= 126) {
            const uint8_t *font = Font5x7[c - 32];
            for (uint8_t col = 0; col < 5; col++) {
                uint16_t fb_idx = x + col + page * OLED_WIDTH;
                if (fb_idx < OLED_FB_SIZE) {
                    oled->framebuffer[fb_idx] = font[col];
                }
            }
            /* 字符间距 1 像素 */
            uint16_t gap_idx = x + 5 + page * OLED_WIDTH;
            if (gap_idx < OLED_FB_SIZE) {
                oled->framebuffer[gap_idx] = 0x00;
            }
        }
        x += 6;
        str++;
    }

    osMutexRelease(oled->fb_mutex);
}

/**
 * @brief 清空显存
 * @note 仅修改显存，不刷新屏幕
 */
void Svc_Oled_Clear(svc_oled_t *oled)
{
    if (oled == NULL) return;

    osMutexAcquire(oled->fb_mutex, osWaitForever);
    memset(oled->framebuffer, 0x00, sizeof(oled->framebuffer));
    osMutexRelease(oled->fb_mutex);
}